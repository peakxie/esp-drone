## main/Kconfig.projbuild
```kconfig
menu "ESPDrone Config"

    choice
        prompt "ESP_Drone hardware version"
        default TARGET_ESP32_S2_DRONE_V1_2 if IDF_TARGET_ESP32S3
        default TARGET_ESP32_S2_DRONE_V1_2 if IDF_TARGET_ESP32S2
        default TARGET_ESPLANE_V1 if IDF_TARGET_ESP32

        config TARGET_ESPLANE_V1
            bool "esplane with esp32 onboard(old version )"

        config TARGET_ESPLANE_V2_S2
            bool "esplane with esp32-s2 onboard"

        config TARGET_ESP32_S2_DRONE_V1_2
            bool "esp-drone with ESP32-S2/ESP32-S3 onboard"

        config TARGET_PYDRONE_S3
            bool "01Studio pyDrone with ESP32-S3 onboard"
            depends on IDF_TARGET_ESP32S3
            help
                01Studio pyDrone v1.0 (ESP32-S3-WROOM-1 N8R8).
                MPU6050 + SPL06-001 barometer + QMC5883L magnetometer on the
                MPU6050 AUX bus. No buzzer, no EEPROM, only 2 controllable LEDs.
                Carries an onboard VL53L1X ToF (on deck I2C1, GPIO1/6) and a
                PMW3901 optical flow sensor on a dedicated SPI bus
                (GPIO17/21/18/8), separate from the Octal PSRAM pins
                (GPIO35/36/37).

    endchoice

    choice
        prompt "extend board version"
        default EXT_AUTO_DETECT
        config EXT_FLOW_TESTBOARD
            bool "use testboard 200616"
            help
                This board use wrong pin definition,only for test.
        config EXT_AUTO_DETECT
            bool "auto detect"
            help
                enable this to use extend board.
    endchoice

    menu "app set"
        config ENABLE_LEGACY_APP
            bool "Enable legacy ESPlane1.0 APP"
            default n
            help
                This enables the udp_server_rx2_task of wifi.
        config ENABLE_POSITION_HOLD_MODE
            bool "Enable position hold mode"
            default y
            help
                This enables position hold mode when pmw3901 sensors available.
        config ENABLE_ALT_HOLD_MODE
            bool "Enable barometric altitude hold mode"
            default n
            help
                Switches to altitude hold when a barometer is present but no
                optical flow deck is. Requires ENABLE_COMMAND_MODE_SET.
                Without flow there is no horizontal observation, so only the
                Z axis can be held; roll/pitch stay in attitude mode.
        config ENABLE_COMMAND_MODE_SET
            bool "Enable \'setCommandermode\' to transform command"
            depends on ENABLE_POSITION_HOLD_MODE || ENABLE_ALT_HOLD_MODE
            default y if ENABLE_POSITION_HOLD_MODE || ENABLE_ALT_HOLD_MODE
            default n
            help
                This enables assit mode when use old version app.
    endmenu

    menu "wireless config"
        config WIFI_BASE_SSID
            string "Wi-Fi Base SSID"
            default "ESP-DRONE"
            help
                Wi-Fi Base SSID, 1-16 characters. the final SSID will be BASE_SSID-MAC
        config WIFI_PASSWORD
            string "Wi-Fi Password"
            default "12345678"
            help
                Wi-Fi Password, 8-64 characters
        config WIFI_CHANNEL
            int "Wi-Fi/ESP-Now Channel"
            range 1 13
            default 6
            help
                Wi-Fi/ESP-Now Channel, 1-13
        config WIFI_MAX_STA_CONN
            int "Wi-Fi Max Station Connection"
            range 1 6
            default 3
            help
                Wi-Fi Max Station Connection, 1-6

        config WIFI_STA_ENABLE
            bool "Join an existing Wi-Fi AP (STA mode) instead of SoftAP"
            default n
            help
                When enabled, ESP-Drone connects to an existing access point
                as a station instead of creating its own SoftAP. cfclient
                must join the same AP and target the IP address the drone
                is assigned by that AP's DHCP server (printed on the serial
                console at boot).

        config WIFI_STA_SSID
            string "Wi-Fi STA SSID"
            depends on WIFI_STA_ENABLE
            default "hcool2.4"
            help
                SSID of the existing access point to join.

        config WIFI_STA_PASSWORD
            string "Wi-Fi STA Password"
            depends on WIFI_STA_ENABLE
            default "3768s631"
            help
                Password of the existing access point, 8-64 characters
                (empty for an open network).
    endmenu

    menu "calibration angle"
        config PITCH_CALIB
            int "PITCH_CALIB deg*100"
            range -200 200
            default 0
            help
                if PITCH error angle is 0.90,set this 90

        config ROLL_CALIB
            int "ROLL_CALIB deg*100"
            range -200 200
            default 0
            help
                if ROLL error angle is 0.90,set this 90
    endmenu

    menu "power distribution"
        config PITCH_DISTRIBUTION_INVERTED
            bool "Invert the pitch term in the motor mix"
            default n
            help
                Flips the sign of the pitch contribution in
                power_distribution_stock.c, i.e.

                  off: m1 = T - r + p + y   (ESP-Drone stock)
                  on:  m1 = T - r - p + y   (01Studio py-drone)

                The two firmwares differ only in this sign; roll and yaw are
                mixed identically. Whether the difference comes from the motor
                numbering or from the IMU mounting orientation cannot be told
                from the source, so this MUST be established on a bench with
                the propellers removed (test T3) rather than assumed.

                Getting it wrong makes the pitch channel positive-feedback:
                the aircraft flips as soon as the stick moves.
    endmenu

    menu "system"

        config BASE_STACK_SIZE
            int "base stack size for system task"
            range 512 1024
            default 1024 if IDF_TARGET_ESP32
            default 512 if IDF_TARGET_ESP32S2
            default 1024 if IDF_TARGET_ESP32S3

    endmenu

    menu "buzzer"

        config BUZZER_ON
            bool "enable buzzer to play sound"
            default n if TARGET_PYDRONE_S3
            default y

        config BUZ1_PIN_POS
            int "BUZ1_PIN_POS GPIO number"
            range 0 34 if TARGET_ESPLANE_V1
            default 27 if TARGET_ESPLANE_V1
            range 0 43 if TARGET_ESPLANE_V2_S2
            default 39 if TARGET_ESPLANE_V2_S2
            range 0 43 if TARGET_ESP32_S2_DRONE_V1_2
            default 39 if TARGET_ESP32_S2_DRONE_V1_2
            range 0 48 if TARGET_PYDRONE_S3
            default 39 if TARGET_PYDRONE_S3
            help
                GPIO number (IOxx) BUZ1_PIN_POS

        config BUZ2_PIN_NEG
            int "BUZ2_PIN_NEG GPIO number"
            range 0 34 if TARGET_ESPLANE_V1
            default 26 if TARGET_ESPLANE_V1
            range 0 43 if TARGET_ESPLANE_V2_S2
            default 38 if TARGET_ESPLANE_V2_S2
            range 0 43 if TARGET_ESP32_S2_DRONE_V1_2
            default 38 if TARGET_ESP32_S2_DRONE_V1_2
            range 0 48 if TARGET_PYDRONE_S3
            default 38 if TARGET_PYDRONE_S3
            help
                GPIO number (IOxx) BUZ2_PIN_NEG

    endmenu

    menu "sensors config"
        config SENSORS_ENABLE_MAG
            bool "Enable the magnetometer on the MPU6050 AUX bus"
            default y if TARGET_PYDRONE_S3
            default n
            help
                Reads the magnetometer through the MPU6050 I2C-master slave
                registers. pyDrone carries a QMC5883L, the ESP-Drone reference
                board an HMC5883L; the driver picks one at compile time.

        choice
            prompt "Magnetometer type"
            depends on SENSORS_ENABLE_MAG
            default MAG_QMC5883L if TARGET_PYDRONE_S3
            default MAG_HMC5883L

            config MAG_HMC5883L
                bool "HMC5883L (0x1E, big endian X/Z/Y)"

            config MAG_QMC5883L
                bool "QMC5883L (0x0D, little endian X/Y/Z)"
        endchoice

        config SENSORS_ENABLE_PRESSURE
            bool "Enable the barometer on the MPU6050 AUX bus"
            default y if TARGET_PYDRONE_S3
            default n
            help
                Needed for barometric altitude hold. pyDrone carries an
                SPL06-001; the ESP-Drone reference board an MS5611 (whose
                read path is unfinished upstream).

        choice
            prompt "Barometer type"
            depends on SENSORS_ENABLE_PRESSURE
            default PRESSURE_SPL06 if TARGET_PYDRONE_S3
            default PRESSURE_MS5611

            config PRESSURE_MS5611
                bool "MS5611 (0x77)"

            config PRESSURE_SPL06
                bool "SPL06-001 (0x76)"
        endchoice

        config SENSORS_ENABLE_DECK
            bool "Enable the Flow Deck sensors (VL53L1X range + PMW3901 flow)"
            default y
            help
                pyDrone carries the VL53L1X on the deck I2C1 bus and the
                PMW3901 on a dedicated SPI bus, separate from the Octal
                PSRAM pins.

        config I2C0_PIN_SDA
            int "I2C0_PIN_SDA GPIO number"
            range 0 34 if TARGET_ESPLANE_V1
            default 21 if TARGET_ESPLANE_V1
            range 0 43 if TARGET_ESPLANE_V2_S2
            default 11 if TARGET_ESPLANE_V2_S2
            range 0 43 if TARGET_ESP32_S2_DRONE_V1_2
            default 11 if TARGET_ESP32_S2_DRONE_V1_2
            range 0 48 if TARGET_PYDRONE_S3
            default 16 if TARGET_PYDRONE_S3
            help
                GPIO number (IOxx) I2C0_PIN_SDA

        config I2C0_PIN_SCL
            int "I2C0_PIN_SCL GPIO number"
            range 0 34 if TARGET_ESPLANE_V1
            default 22 if TARGET_ESPLANE_V1
            range 0 43 if TARGET_ESPLANE_V2_S2
            default 10 if TARGET_ESPLANE_V2_S2
            range 0 43 if TARGET_ESP32_S2_DRONE_V1_2
            default 10 if TARGET_ESP32_S2_DRONE_V1_2
            range 0 48 if TARGET_PYDRONE_S3
            default 15 if TARGET_PYDRONE_S3
            help
                GPIO number (IOxx) I2C0_PIN_SCL

        config I2C1_PIN_SDA
            int "I2C1_PIN_SDA GPIO number"
            range 0 34 if TARGET_ESPLANE_V1
            default 16 if TARGET_ESPLANE_V1
            range 0 43 if TARGET_ESPLANE_V2_S2
            default 40 if TARGET_ESPLANE_V2_S2
            range 0 43 if TARGET_ESP32_S2_DRONE_V1_2
            default 40 if TARGET_ESP32_S2_DRONE_V1_2
            range 0 48 if TARGET_PYDRONE_S3
            default 6 if TARGET_PYDRONE_S3
            help
                GPIO number (IOxx) I2C1_PIN_SDA.
                DANGER for pyDrone: GPIO40/41 drive the M3/M4 motor MOSFETs.
                Never point the deck bus at them - the open-drain + pull-up
                config would spin those motors during init.

        config I2C1_PIN_SCL
            int "I2C1_PIN_SCL GPIO number"
            range 0 34 if TARGET_ESPLANE_V1
            default 17 if TARGET_ESPLANE_V1
            range 0 43 if TARGET_ESPLANE_V2_S2
            default 41 if TARGET_ESPLANE_V2_S2
            range 0 43 if TARGET_ESP32_S2_DRONE_V1_2
            default 41 if TARGET_ESP32_S2_DRONE_V1_2
            range 0 48 if TARGET_PYDRONE_S3
            default 1 if TARGET_PYDRONE_S3
            help
                GPIO number (IOxx) I2C1_PIN_SCL.
                See the I2C1_PIN_SDA warning about GPIO40/41 on pyDrone.

        config SPI_PIN_MISO
            int "SPI_PIN_MISO GPIO number"
            range 0 34 if TARGET_ESPLANE_V1
            default 12 if TARGET_ESPLANE_V1
            range 0 43 if TARGET_ESPLANE_V2_S2
            default 37 if TARGET_ESPLANE_V2_S2
            range 0 43 if TARGET_ESP32_S2_DRONE_V1_2
            default 37 if TARGET_ESP32_S2_DRONE_V1_2
            range 0 48 if TARGET_PYDRONE_S3
            default 17 if TARGET_PYDRONE_S3
            help
                GPIO number (IOxx) SPI_PIN_MISO.
                pyDrone's onboard PMW3901 uses a dedicated SPI bus
                (GPIO17/21/18/8), separate from the Octal PSRAM pins
                (GPIO35/36/37).

        config SPI_PIN_MOSI
            int "SPI_PIN_MOSI GPIO number"
            range 0 34 if TARGET_ESPLANE_V1
            default 13 if TARGET_ESPLANE_V1
            range 0 43 if TARGET_ESPLANE_V2_S2
            default 35 if TARGET_ESPLANE_V2_S2
            range 0 43 if TARGET_ESP32_S2_DRONE_V1_2
            default 35 if TARGET_ESP32_S2_DRONE_V1_2
            range 0 48 if TARGET_PYDRONE_S3
            default 21 if TARGET_PYDRONE_S3
            help
                GPIO number (IOxx) SPI_PIN_MOSI

        config SPI_PIN_CLK
            int "SPI_PIN_CLK GPIO number"
            range 0 34 if TARGET_ESPLANE_V1
            default 14 if TARGET_ESPLANE_V1
            range 0 43 if TARGET_ESPLANE_V2_S2
            default 36 if TARGET_ESPLANE_V2_S2
            range 0 43 if TARGET_ESP32_S2_DRONE_V1_2
            default 36 if TARGET_ESP32_S2_DRONE_V1_2
            range 0 48 if TARGET_PYDRONE_S3
            default 18 if TARGET_PYDRONE_S3
            help
                GPIO number (IOxx) SPI_PIN_CLK

        config SPI_PIN_CS0
            int "SPI_PIN_CS0 GPIO number"
            range 0 34 if TARGET_ESPLANE_V1
            default 15 if TARGET_ESPLANE_V1
            range 0 43 if TARGET_ESPLANE_V2_S2
            default 34 if TARGET_ESPLANE_V2_S2
            range 0 43 if TARGET_ESP32_S2_DRONE_V1_2
            default 34 if TARGET_ESP32_S2_DRONE_V1_2
            range 0 48 if TARGET_PYDRONE_S3
            default 8 if TARGET_PYDRONE_S3
            help
                GPIO number (IOxx) SPI_PIN_CS0

        config MPU_PIN_INT
            int "MPU_PIN_INT GPIO number"
            range 0 34 if TARGET_ESPLANE_V1
            default 19 if TARGET_ESPLANE_V1
            range 0 43 if TARGET_ESPLANE_V2_S2
            default 12 if TARGET_ESPLANE_V2_S2
            range 0 43 if TARGET_ESP32_S2_DRONE_V1_2
            default 12 if TARGET_ESP32_S2_DRONE_V1_2
            range 0 48 if TARGET_PYDRONE_S3
            default 7 if TARGET_PYDRONE_S3
            help
                GPIO number (IOxx) MPU_PIN_INT

        config ADC1_PIN
            int "EXT01_PIN GPIO number"
            range 32 39 if TARGET_ESPLANE_V1
            default 35 if TARGET_ESPLANE_V1
            range 1 10 if TARGET_ESPLANE_V2_S2
            default 2 if TARGET_ESPLANE_V2_S2
            range 1 10 if TARGET_ESP32_S2_DRONE_V1_2
            default 2 if TARGET_ESP32_S2_DRONE_V1_2
            range 1 10 if TARGET_PYDRONE_S3
            default 2 if TARGET_PYDRONE_S3
            help
                GPIO number (IOxx) ADC1_PIN

        config BAT_DIVIDER_RATIO
            int "Battery divider ratio (Vbat/Vadc) * 100"
            range 100 2000
            default 502 if TARGET_PYDRONE_S3
            default 200
            help
                Resistor divider ratio on the battery sense node, scaled by 100.
                pyDrone uses R4 40.2k / R7 10k -> (40.2 + 10) / 10 = 5.02, so
                set 502. Boards with a 1:1 divider use 200.

        config BAT_ADC_ATTEN_0DB
            bool "Use 0 dB ADC attenuation for battery sense"
            default y if TARGET_PYDRONE_S3
            default n
            help
                With the pyDrone 5.02 divider a full 4.2 V battery lands at
                0.836 V, inside the 0 dB (~1.1 V) full scale, so 0 dB keeps the
                best resolution. Boards with a 1:1 divider need the default
                11/12 dB attenuation to reach ~2.1 V.

        config EXT01_PIN
            int "EXT01_PIN GPIO number"
            range 0 34 if TARGET_ESPLANE_V1
            default 34 if TARGET_ESPLANE_V1
            range 0 43 if TARGET_ESPLANE_V2_S2
            default 1 if TARGET_ESPLANE_V2_S2
            range 0 43 if TARGET_ESP32_S2_DRONE_V1_2
            default 1 if TARGET_ESP32_S2_DRONE_V1_2
            range 0 48 if TARGET_PYDRONE_S3
            default 1 if TARGET_PYDRONE_S3
            help
                GPIO number (IOxx) EXT01_PIN
    endmenu

    menu "led config"
        config LED_PIN_BLUE
            int "LED_PIN_BLUE GPIO number"
            range 0 34 if TARGET_ESPLANE_V1
            default 18 if TARGET_ESPLANE_V1
            range 0 43 if TARGET_ESPLANE_V2_S2
            default 7 if TARGET_ESPLANE_V2_S2
            range 0 43 if TARGET_ESP32_S2_DRONE_V1_2
            default 7 if TARGET_ESP32_S2_DRONE_V1_2
            range 0 48 if TARGET_PYDRONE_S3
            default 46 if TARGET_PYDRONE_S3
            help
                GPIO number (IOxx) LED_PIN_BLUE

        config LED_PIN_GREEN
            int "LED_PIN_GREEN GPIO number"
            range 0 34 if TARGET_ESPLANE_V1
            default 5 if TARGET_ESPLANE_V1
            range 0 43 if TARGET_ESPLANE_V2_S2
            default 9 if TARGET_ESPLANE_V2_S2
            range 0 43 if TARGET_ESP32_S2_DRONE_V1_2
            default 9 if TARGET_ESP32_S2_DRONE_V1_2
            range 0 48 if TARGET_PYDRONE_S3
            default 42 if TARGET_PYDRONE_S3
            help
                GPIO number (IOxx) LED_PIN_GREEN

        config LED_PIN_RED
            int "LED_PIN_RED GPIO number"
            depends on !TARGET_PYDRONE_S3
            range 0 34 if TARGET_ESPLANE_V1
            default 23 if TARGET_ESPLANE_V1
            range 0 43 if TARGET_ESPLANE_V2_S2
            default 8 if TARGET_ESPLANE_V2_S2
            range 0 43 if TARGET_ESP32_S2_DRONE_V1_2
            default 8 if TARGET_ESP32_S2_DRONE_V1_2
            help
                GPIO number (IOxx) LED_PIN_RED.
                pyDrone has no programmable red LED: the red one is hard-wired
                to the power rail and the yellow one is the charger STAT pin.

    endmenu

    menu "motors config"
        choice
            prompt "Motor type"
            default MOTOR_BRUSHED_715 if TARGET_ESPLANE_V1 || TARGET_ESPLANE_V2_S2
            default MOTOR_BRUSHED_720 if TARGET_ESP32_S2_DRONE_V1_2
            default MOTOR_BRUSHED_715 if TARGET_PYDRONE_S3

            config MOTOR_BRUSHED_715
                bool "brushed 715 motor"

            config MOTOR_BRUSHED_720
                bool "brushed 720 motor"
        endchoice

        config MOTOR01_PIN
            int "MOTOR01_PIN GPIO number"
            range 0 34 if TARGET_ESPLANE_V1
            default 4 if TARGET_ESPLANE_V1
            range 0 43 if TARGET_ESPLANE_V2_S2
            default 3 if TARGET_ESPLANE_V2_S2
            range 0 43 if TARGET_ESP32_S2_DRONE_V1_2
            default 5 if TARGET_ESP32_S2_DRONE_V1_2
            range 0 48 if TARGET_PYDRONE_S3
            default 4 if TARGET_PYDRONE_S3
            help
                GPIO number (IOxx) MOTOR01_PIN

        config MOTOR02_PIN
            int "MOTOR02_PIN GPIO number"
            range 0 34 if TARGET_ESPLANE_V1
            default 33 if TARGET_ESPLANE_V1
            range 0 43 if TARGET_ESPLANE_V2_S2
            default 4 if TARGET_ESPLANE_V2_S2
            range 0 43 if TARGET_ESP32_S2_DRONE_V1_2
            default 6 if TARGET_ESP32_S2_DRONE_V1_2
            range 0 48 if TARGET_PYDRONE_S3
            default 5 if TARGET_PYDRONE_S3
            help
                GPIO number (IOxx) MOTOR02_PIN

        config MOTOR03_PIN
            int "MOTOR03_PIN GPIO number"
            range 0 34 if TARGET_ESPLANE_V1
            default 32 if TARGET_ESPLANE_V1
            range 0 43 if TARGET_ESPLANE_V2_S2
            default 5 if TARGET_ESPLANE_V2_S2
            range 0 43 if TARGET_ESP32_S2_DRONE_V1_2
            default 3 if TARGET_ESP32_S2_DRONE_V1_2
            range 0 48 if TARGET_PYDRONE_S3
            default 40 if TARGET_PYDRONE_S3
            help
                GPIO number (IOxx) MOTOR03_PIN

        config MOTOR04_PIN
            int "MOTOR04_PIN GPIO number"
            range 0 34 if TARGET_ESPLANE_V1
            default 25 if TARGET_ESPLANE_V1
            range 0 43 if TARGET_ESPLANE_V2_S2
            default 6 if TARGET_ESPLANE_V2_S2
            range 0 43 if TARGET_ESP32_S2_DRONE_V1_2
            default 4 if TARGET_ESP32_S2_DRONE_V1_2
            range 0 48 if TARGET_PYDRONE_S3
            default 41 if TARGET_PYDRONE_S3
            help
                GPIO number (IOxx) MOTOR04_PIN
    endmenu


endmenu
```
